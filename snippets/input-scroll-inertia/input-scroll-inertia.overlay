/* 慣性スクロールは central 側でのみ動作する (ZMK のマウス HID API が
 * central でしかコンパイルされないため)。右手側 central のビルドでのみ
 * この snippet を指定して有効化する。 */

&scroll_inertia_free {
    status = "okay";
};

/* ズームの段送りも同じ理由 (HID API を使う) で central 専用。
 * チェーン上で慣性の直前に並んでいるので、組で有効化する。 */
&zip_zoom_step {
    status = "okay";
};
